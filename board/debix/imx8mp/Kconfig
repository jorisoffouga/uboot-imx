## board/debix/imx8mp/Kconfig
```kconfig
if TARGET_DEBIX_IMX8MP

config SYS_BOARD
	default "imx8mp"

config SYS_VENDOR
	default "debix"

config SYS_CONFIG_NAME
	default "imx8mp_debix"

config IMX_CONFIG
	default "board/debix/imx8mp/imximage-8mp-lpddr4.cfg"

endif
```
